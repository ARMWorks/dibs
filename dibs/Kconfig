## dibs/Kconfig
```kconfig
mainmenu "DIBS for $DIBS_BOARD"

config DIBS_BOARD
	string
	option env="DIBS_BOARD"

config BOARD
	string 
	default DIBS_BOARD

config SOC
	string
	default "s3c2451" if DIBS_BOARD="mini2451" || DIBS_BOARD="nanopi"
	default "s5p6818" if DIBS_BOARD="nanopi_fire3" || DIBS_BOARD="nanopc_t3_plus"
	default "unknown"

source "dibs/Kconfig.platform"
source "config/Kconfig.packages"
source "dibs/Kconfig.system"
source "dibs/Kconfig.network"
source "dibs/Kconfig.image"
```

## dibs/Kconfig.image
```kconfig
menu "Image"
	config IMAGE_PARTITION_BOOT
		bool "Boot partition"
	if IMAGE_PARTITION_BOOT
		config IMAGE_PARTITION_BOOT_SIZE
			int "Boot partition size (in MiB)"
			default 100
		choice IMAGE_PARTITION_BOOT_TYPE
			prompt "Boot partition type"
			default IMAGE_PARTITION_BOOT_TYPE_FAT32
			config IMAGE_PARTITION_BOOT_TYPE_EXT2
				bool "ext2"
			config IMAGE_PARTITION_BOOT_TYPE_EXT3
				bool "ext3"
			config IMAGE_PARTITION_BOOT_TYPE_EXT4
				bool "ext4"
			config IMAGE_PARTITION_BOOT_TYPE_FAT32
				bool "fat32"
		endchoice
	endif
	config IMAGE_PARTITION_SWAP
		bool "Swap partition"
	if IMAGE_PARTITION_SWAP
		config IMAGE_PARTITION_SWAP_EMBED
			bool "Embed swap partition in image" if IMAGE_PARTITION_BOOT
		config IMAGE_PARTITION_SWAP_SIZE
			int "Swap partition size (in MiB)"
			default 512
	endif
	choice IMAGE_PARTITION_ROOT_TYPE
		prompt "Root partition type"
		default IMAGE_PARTITION_ROOT_TYPE_EXT4
		config IMAGE_PARTITION_ROOT_TYPE_EXT2
			bool "ext2"
		config IMAGE_PARTITION_ROOT_TYPE_EXT3
			bool "ext3"
		config IMAGE_PARTITION_ROOT_TYPE_EXT4
			bool "ext4"
	endchoice
endmenu
```

## dibs/Kconfig.network
```kconfig
menu "Network"
	config NETWORK_HOSTNAME
		string "Hostname"
		default "dibs"

	menuconfig NETWORK_RESOLVER
		bool "Resolver configuration"
	if NETWORK_RESOLVER
		config NETWORK_RESOLVER_DOMAIN
			string "domain"
		config NETWORK_RESOLVER_SEARCH
			string "search"
		config NETWORK_RESOLVER_NS1
			string "nameserver"
			default "8.8.8.8"
		config NETWORK_RESOLVER_NS2
			string "nameserver"
			default "8.8.4.4"
	endif

	menuconfig NETWORK_ETH0
		depends on PACKAGE_NET_TOOLS
		depends on PACKAGE_IFUPDOWN
		bool "eth0"
	if NETWORK_ETH0
		choice NETWORK_ETH0_IP_TYPE
			prompt "IP Type"
			config NETWORK_ETH0_IP_TYPE_DHCP
				depends on PACKAGE_ISC_DHCP_CLIENT
				bool "DHCP"
			config NETWORK_ETH0_IP_TYPE_MANUAL
				bool "Manual"
			config NETWORK_ETH0_IP_TYPE_STATIC
				bool "Static"
		endchoice
		if NETWORK_ETH0_IP_TYPE_STATIC
			config NETWORK_ETH0_IP_ADDR
				string "IP Address"
			config NETWORK_ETH0_IP_NETMASK
				string "Netmask"
			config NETWORK_ETH0_IP_GATEWAY
				string "Gateway"
		endif
	endif

	menuconfig NETWORK_WLAN0
		depends on PACKAGE_NET_TOOLS
		depends on PACKAGE_IFUPDOWN
		depends on PACKAGE_WIRELESS_TOOLS
		bool "wlan0"
	if NETWORK_WLAN0
		config NETWORK_WLAN0_SSID
			string "SSID"
		choice NETWORK_WLAN0_TYPE
			prompt "Network type"
			config NETWORK_WLAN0_TYPE_OPEN
				bool "Open"
			config NETWORK_WLAN0_TYPE_WEP
				bool "WEP"
			config NETWORK_WLAN0_TYPE_WPA
				depends on PACKAGE_WPASUPPLICANT
				bool "WPA"
			config NETWORK_WLAN0_TYPE_WPA2
				depends on PACKAGE_WPASUPPLICANT
				bool "WPA2"
		endchoice
		config NETWORK_WLAN0_KEY
			depends on NETWORK_WLAN0_TYPE_WEP || NETWORK_WLAN0_TYPE_WPA || NETWORK_WLAN0_TYPE_WPA2
			string "Key"
		choice NETWORK_WLAN0_IP_TYPE
			prompt "IP Type"
			config NETWORK_WLAN0_IP_TYPE_DHCP
				depends on PACKAGE_ISC_DHCP_CLIENT
				bool "DHCP"
			config NETWORK_WLAN0_IP_TYPE_MANUAL
				bool "Manual"
			config NETWORK_WLAN0_IP_TYPE_STATIC
				bool "Static"
		endchoice
		if NETWORK_WLAN0_IP_TYPE_STATIC
			config NETWORK_WLAN0_IP_ADDR
				string "IP Address"
			config NETWORK_WLAN0_IP_NETMASK
				string "Netmask"
			config NETWORK_WLAN0_IP_GATEWAY
				string "Gateway"
		endif
	endif
endmenu
```

## dibs/Kconfig.packages
```kconfig
menu "Packages"
	config PACKAGE_USERDEFINED
		string "User defined, space separated list"
	config PACKAGE_APT
		bool apt
	config PACKAGE_BLUEZ
		bool bluez
	config PACKAGE_CRDA
		bool crda
	config PACKAGE_DNSUTILS
		bool dnsutils
	config PACKAGE_DOSFSTOOLS
		bool dosfstools
	config PACKAGE_DROPBEAR
		bool dropbear
	config PACKAGE_IFUPDOWN
		bool ifupdown
	config PACKAGE_IPUTILS_PING
		bool iputils-ping
	config PACKAGE_ISC_DHCP_CLIENT
		bool isc-dhcp-client
	config PACKAGE_KMOD
		bool kmod
	config PACKAGE_LESS
		bool less
	config PACKAGE_LIBBLUETOOTH3
		bool libbluetooth3
	config PACKAGE_LOCALES
		bool locales
	config PACKAGE_NET_TOOLS
		bool net-tools
	config PACKAGE_PARTED
		bool parted
	config PACKAGE_VIM_TINY
		bool vim-tiny
	config PACKAGE_WIRELESS_TOOLS
		bool wireless-tools
	config PACKAGE_WPASUPPLICANT
		bool wpasupplicant
endmenu
```

## dibs/Kconfig.platform
```kconfig
menu "Platform"
	choice ARCH
		prompt "Architecture"
		config ARCH_AMD64
			bool "amd64"
			depends on BOARD="generic"
		config ARCH_ARM64
			bool "arm64"
			depends on BOARD="generic" || BOARD="nanopi_neo_plus2"
		config ARCH_ARMEL
			bool "armel"
			depends on BOARD="generic" || BOARD="nanopi" || BOARD="nanopi2"
		config ARCH_ARMHF
			bool "armhf"
			depends on BOARD="generic" || BOARD="nanopi2"
		config ARCH_I386
			bool "i386"
			depends on BOARD="generic"
	endchoice

	choice DISTRO
		prompt "Distribution"
		config DISTRO_DEBIAN
			bool "Debian"
		config DISTRO_UBUNTU
			bool "Ubuntu"
	endchoice

	if DISTRO_DEBIAN
		choice RELEASE_DEBIAN
			prompt "Release"
			default RELEASE_DEBIAN_STRETCH
			config RELEASE_DEBIAN_WHEEZY
				bool "7 - Wheezy"
			config RELEASE_DEBIAN_JESSIE
				bool "8 - Jessie"
			config RELEASE_DEBIAN_STRETCH
				bool "9 - Stretch"
			config RELEASE_DEBIAN_TESTING
				bool "Testing"
		endchoice
	endif

	if DISTRO_UBUNTU
		choice RELEASE_UBUNTU
			prompt "Release"
			default RELEASE_UBUNTU_XENIAL
			config RELEASE_UBUNTU_TRUSTY
				bool "14.04 - Trusty Tahr"
			config RELEASE_UBUNTU_XENIAL
				bool "16.04 - Xenial Xerus"
			config RELEASE_UBUNTU_ZESTY
				bool "17.04 - Zesty Zapus"
			config RELEASE_UBUNTU_ARTFUL
				bool "17.10 - Artful Aardvark"
		endchoice
	endif

	config USE_SYSVINIT
		bool "Use sysvinit instead of systemd"
		depends on RELEASE_DEBIAN_JESSIE || RELEASE_DEBIAN_STRETCH || RELEASE_DEBIAN_TESTING

source "board/Kconfig"

endmenu
```

## dibs/Kconfig.system
```kconfig
menu "System"
	menu "Accounts"
		config SYSTEM_ROOT_PASSWORD
			string "Root Password"
		menuconfig SYSTEM_USER_ADD
			bool "Add User"
		if SYSTEM_USER_ADD
			config SYSTEM_USER_USERNAME
				string "Username"
			config SYSTEM_USER_PASSWORD
				string "Password"
			config SYSTEM_USER_GROUPS
				string "Groups"
		endif
	endmenu
	menu "Remove files"
		config SYSTEM_REMOVE_DOCUMENTATION
			bool "Remove documentation"
		config SYSTEM_REMOVE_LINTIAN
			bool "Remove lintian files"
		config SYSTEM_REMOVE_LOCALES
			bool "Remove locales"
		config SYSTEM_RETAIN_LOCALES
			string "Retain these locales"
			depends on SYSTEM_REMOVE_LOCALES
			default "en_US"
	endmenu
	config SYSTEM_LOCALE
		string "Locale"
		depends on PACKAGE_LOCALES
		depends on !(SYSTEM_REMOVE_LOCALES && SYSTEM_RETAIN_LOCALES = "")
		default "en_US.UTF-8"
endmenu
```

## kconfig/Kconfig
```kconfig
mainmenu "DIBS"

choice ARCH
	prompt "Architecture"
	config ARCH_AMD64
		bool "amd64"
	config ARCH_ARMEL
		bool "armel"
	config ARCH_ARMHF
		bool "armhf"
	config ARCH_ARM64
		bool "arm64"
	config ARCH_I386
		bool "i386"
endchoice

choice BOARD
	prompt "Board"
	config BOARD_NANOPI
		bool "NanoPi"
		depends on ARCH_ARMEL
	config BOARD_NANOPI2
		bool "NanoPi 2"
		depends on ARCH_ARMEL || ARCH_ARMHF
endchoice

source "kconfig/Kconfig.nanopi"
```
